## Kconfig.sample
```kconfig
config MLX_BOOTCTL
	tristate "Mellanox BlueField Firmware Boot Control"
	default m
	depends on ARM64
	help
	  The Mellanox BlueField firmware implements functionality to
	  request swapping the primary and alternate eMMC boot
	  partition, and to set up a watchdog that can undo that swap
	  if the system does not boot up correctly.  This driver
	  provides sysfs access to the firmware, to be used in
	  conjunction with the eMMC device driver to do any necessary
	  initial swap of the boot partition.
```
